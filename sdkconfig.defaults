## sdkconfig.defaults
```kconfig
# Solarpunk Wearable - SDK Configuration Defaults

# Enable WebSocket support in HTTP server
CONFIG_HTTPD_WS_SUPPORT=y

# WiFi
CONFIG_ESP_WIFI_SOFTAP_SUPPORT=y

# ESP-NOW
CONFIG_ESP_WIFI_ESPNOW_MAX_ENCRYPT_NUM=0

# SPIFFS for script storage
CONFIG_SPIFFS_MAX_PARTITIONS=1

# Power saving
CONFIG_PM_ENABLE=y
CONFIG_FREERTOS_USE_TICKLESS_IDLE=y

# Reduce binary size
CONFIG_COMPILER_OPTIMIZATION_SIZE=y
CONFIG_LOG_DEFAULT_LEVEL_INFO=y
CONFIG_BOOTLOADER_LOG_LEVEL_WARN=y

# Partition table - need SPIFFS partition
CONFIG_PARTITION_TABLE_CUSTOM=y
CONFIG_PARTITION_TABLE_CUSTOM_FILENAME="partitions.csv"
```
